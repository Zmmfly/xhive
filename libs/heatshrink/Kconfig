## libs/heatshrink/Kconfig
```kconfig
choice
    prompt "HeatsShrink Memory Allocation Method"
    default HEATSHRINK_DYNAMIC_ALLOC

    config HEATSHRINK_DYNAMIC_ALLOC
        bool "Dynamic Memory Allocation"
        help
          Use dynamic memory allocation (malloc/free) for HeatsShrink buffers.

    config HEATSHRINK_STATIC_ALLOC
        bool "Static Memory Allocation"
        help
          Use static memory allocation for HeatsShrink buffers.
endchoice

config HEATSHRINK_STATIC_INPUT_BUFFER_SIZE
    int "HeatsShrink Static Input Buffer Size"
    depends on HEATSHRINK_STATIC_ALLOC
    default 32
    help
      Specify the size of the static input buffer to be used by HeatsShrink when static memory allocation is selected.

config HEATSHRINK_STATIC_WINDOWS_BITS
    int "HeatsShrink Static Window Size (in bits)"
    depends on HEATSHRINK_STATIC_ALLOC
    default 8
    help
      Specify the window size (in bits) to be used by HeatsShrink when static memory allocation is selected.

config HEATSHRINK_STATIC_LOOKAHEAD_BITS
    int "HeatsShrink Static Lookahead Size (in bits)"
    depends on HEATSHRINK_STATIC_ALLOC
    default 4
    help
      Specify the lookahead size (in bits) to be used by HeatsShrink when static memory allocation is selected.
```

## libs/micro-ecc/Kconfig
```kconfig
config MICRO_ECC_ENABLE_SECP160R1
    bool "Enable secp160r1 Curve Support"
    default y
    help
        Enable support for the secp160r1 elliptic curve in the micro-ecc library.

config MICRO_ECC_ENABLE_SECP192R1
    bool "Enable secp192r1 Curve Support"
    default y
    help
        Enable support for the secp192r1 elliptic curve in the micro-ecc library.

config MICRO_ECC_ENABLE_SECP224R1
    bool "Enable secp224r1 Curve Support"
    default y
    help
        Enable support for the secp224r1 elliptic curve in the micro-ecc library.

config MICRO_ECC_ENABLE_SECP256R1
    bool "Enable secp256r1 Curve Support"
    default y
    help
        Enable support for the secp256r1 elliptic curve in the micro-ecc library.

config MICRO_ECC_ENABLE_SECP256K1
    bool "Enable secp256k1 Curve Support"
    default y
    help
        Enable support for the secp256k1 elliptic curve in the micro-ecc library.

config MICRO_ECC_ENABLE_COMPRESSED_POINT
    bool "Enable Compressed Point Support"
    default y
    help
        Enable support for compressed points in the micro-ecc library, which reduces the size of public keys.
```

## vendor/Kconfig
```kconfig
menu "MCU Vendor Selection"

choice
    prompt "Select MCU Vendor"
    default VENDOR_USE_NATION
    help
      Select the microcontroller vendor to use.

config VENDOR_USE_NATION
    bool "Use Nation MCU"
    select CLOCK_PLLM_DISABLED
    select CLOCK_PLLN_DISABLED
    select CLOCK_PLLP_DISABLED
    select CLOCK_SYSFREQ_DISABLED
    help
      Select this option to include Nation vendor-specific configurations.

config VENDOR_USE_STMICRO
    bool "Use STMicroelectronics MCU"
    help
      Select this option to include STMicroelectronics vendor-specific configurations.

config VENDOR_USE_NONE
    bool "No Specific Vendor"
    help
      Select this option if you do not want to include any vendor-specific configurations.

endchoice

if VENDOR_USE_NATION
    orsource "nation/Kconfig"
endif

if VENDOR_USE_STMICRO
    orsource "stmicro/Kconfig"
endif

endmenu
```
